&dsi_ilitek_ili7807s_video {
	qcom,mdss-dsi-display-timings {
		timing@0 {

			qcom,mdss-dsi-on-command = [
				29 01 00 00 00 00 04 FF 78 07 01
				29 01 00 00 00 00 02 00 62
				29 01 00 00 00 00 02 01 11
				29 01 00 00 00 00 02 02 00
				29 01 00 00 00 00 02 03 00
				29 01 00 00 00 00 02 04 00
				29 01 00 00 00 00 02 05 00
				29 01 00 00 00 00 02 06 00
				29 01 00 00 00 00 02 07 00
				29 01 00 00 00 00 02 08 A9
				29 01 00 00 00 00 02 09 0A
				29 01 00 00 00 00 02 0A 30
				29 01 00 00 00 00 02 0B 00
				29 01 00 00 00 00 02 0C 00
				29 01 00 00 00 00 02 0D 00
				29 01 00 00 00 00 02 0E 04
				29 01 00 00 00 00 02 31 07
				29 01 00 00 00 00 02 32 07
				29 01 00 00 00 00 02 33 07
				29 01 00 00 00 00 02 34 07
				29 01 00 00 00 00 02 35 07
				29 01 00 00 00 00 02 36 07
				29 01 00 00 00 00 02 37 07
				29 01 00 00 00 00 02 38 41
				29 01 00 00 00 00 02 39 41
				29 01 00 00 00 00 02 3A 02
				29 01 00 00 00 00 02 3B 25
				29 01 00 00 00 00 02 3C 28
				29 01 00 00 00 00 02 3D 28
				29 01 00 00 00 00 02 3E 30
				29 01 00 00 00 00 02 3F 2F
				29 01 00 00 00 00 02 40 2E
				29 01 00 00 00 00 02 41 10
				29 01 00 00 00 00 02 42 12
				29 01 00 00 00 00 02 43 2C
				29 01 00 00 00 00 02 44 40
				29 01 00 00 00 00 02 45 40
				29 01 00 00 00 00 02 46 01
				29 01 00 00 00 00 02 47 00
				29 01 00 00 00 00 02 48 08
				29 01 00 00 00 00 02 49 07
				29 01 00 00 00 00 02 4A 07
				29 01 00 00 00 00 02 4B 07
				29 01 00 00 00 00 02 4C 07
				29 01 00 00 00 00 02 4D 07
				29 01 00 00 00 00 02 4E 07
				29 01 00 00 00 00 02 4F 07
				29 01 00 00 00 00 02 50 41
				29 01 00 00 00 00 02 51 41
				29 01 00 00 00 00 02 52 02
				29 01 00 00 00 00 02 53 25
				29 01 00 00 00 00 02 54 28
				29 01 00 00 00 00 02 55 28
				29 01 00 00 00 00 02 56 30
				29 01 00 00 00 00 02 57 2F
				29 01 00 00 00 00 02 58 2E
				29 01 00 00 00 00 02 59 11
				29 01 00 00 00 00 02 5A 13
				29 01 00 00 00 00 02 5B 2C
				29 01 00 00 00 00 02 5C 40
				29 01 00 00 00 00 02 5D 40
				29 01 00 00 00 00 02 5E 01
				29 01 00 00 00 00 02 5F 00
				29 01 00 00 00 00 02 60 09
				29 01 00 00 00 00 02 61 07
				29 01 00 00 00 00 02 62 07
				29 01 00 00 00 00 02 63 07
				29 01 00 00 00 00 02 64 07
				29 01 00 00 00 00 02 65 07
				29 01 00 00 00 00 02 66 07
				29 01 00 00 00 00 02 67 07
				29 01 00 00 00 00 02 68 41
				29 01 00 00 00 00 02 69 41
				29 01 00 00 00 00 02 6A 02
				29 01 00 00 00 00 02 6B 25
				29 01 00 00 00 00 02 6C 28
				29 01 00 00 00 00 02 6D 28
				29 01 00 00 00 00 02 6E 30
				29 01 00 00 00 00 02 6F 2F
				29 01 00 00 00 00 02 70 2E
				29 01 00 00 00 00 02 71 13
				29 01 00 00 00 00 02 72 11
				29 01 00 00 00 00 02 73 2C
				29 01 00 00 00 00 02 74 40
				29 01 00 00 00 00 02 75 40
				29 01 00 00 00 00 02 76 01
				29 01 00 00 00 00 02 77 00
				29 01 00 00 00 00 02 78 09
				29 01 00 00 00 00 02 79 07
				29 01 00 00 00 00 02 7A 07
				29 01 00 00 00 00 02 7B 07
				29 01 00 00 00 00 02 7C 07
				29 01 00 00 00 00 02 7D 07
				29 01 00 00 00 00 02 7E 07
				29 01 00 00 00 00 02 7F 07
				29 01 00 00 00 00 02 80 41
				29 01 00 00 00 00 02 81 41
				29 01 00 00 00 00 02 82 02
				29 01 00 00 00 00 02 83 25
				29 01 00 00 00 00 02 84 28
				29 01 00 00 00 00 02 85 28
				29 01 00 00 00 00 02 86 30
				29 01 00 00 00 00 02 87 2F
				29 01 00 00 00 00 02 88 2E
				29 01 00 00 00 00 02 89 12
				29 01 00 00 00 00 02 8A 10
				29 01 00 00 00 00 02 8B 2C
				29 01 00 00 00 00 02 8C 40
				29 01 00 00 00 00 02 8D 40
				29 01 00 00 00 00 02 8E 01
				29 01 00 00 00 00 02 8F 00
				29 01 00 00 00 00 02 90 08
				29 01 00 00 00 00 02 A0 4C
				29 01 00 00 00 00 02 A1 4A
				29 01 00 00 00 00 02 A2 00
				29 01 00 00 00 00 02 A3 00
				29 01 00 00 00 00 02 A7 10
				29 01 00 00 00 00 02 AA 00
				29 01 00 00 00 00 02 AB 00
				29 01 00 00 00 00 02 AC 00
				29 01 00 00 00 00 02 AE 00
				29 01 00 00 00 00 02 B0 20
				29 01 00 00 00 00 02 B1 00
				29 01 00 00 00 00 02 B2 02
				29 01 00 00 00 00 02 B3 04
				29 01 00 00 00 00 02 B4 05
				29 01 00 00 00 00 02 B5 00
				29 01 00 00 00 00 02 B6 00
				29 01 00 00 00 00 02 B7 00
				29 01 00 00 00 00 02 B8 00
				29 01 00 00 00 00 02 C0 0C
				29 01 00 00 00 00 02 C1 05
				29 01 00 00 00 00 02 C2 00
				29 01 00 00 00 00 02 C3 00
				29 01 00 00 00 00 02 C4 00
				29 01 00 00 00 00 02 C5 2B
				29 01 00 00 00 00 02 C6 00
				29 01 00 00 00 00 02 C7 28
				29 01 00 00 00 00 02 C8 00
				29 01 00 00 00 00 02 C9 00
				29 01 00 00 00 00 02 CA 01
				29 01 00 00 00 00 02 D0 01
				29 01 00 00 00 00 02 D1 00
				29 01 00 00 00 00 02 D2 10
				29 01 00 00 00 00 02 D3 41
				29 01 00 00 00 00 02 D4 89
				29 01 00 00 00 00 02 D5 06
				29 01 00 00 00 00 02 D6 49
				29 01 00 00 00 00 02 D7 40
				29 01 00 00 00 00 02 D8 09
				29 01 00 00 00 00 02 D9 96
				29 01 00 00 00 00 02 DA AA
				29 01 00 00 00 00 02 DB AA
				29 01 00 00 00 00 02 DC 8A
				29 01 00 00 00 00 02 DD A8
				29 01 00 00 00 00 02 DE 05
				29 01 00 00 00 00 02 DF 42
				29 01 00 00 00 00 02 E0 1E
				29 01 00 00 00 00 02 E1 68
				29 01 00 00 00 00 02 E2 05
				29 01 00 00 00 00 02 E3 11
				29 01 00 00 00 00 02 E4 42
				29 01 00 00 00 00 02 E5 4B
				29 01 00 00 00 00 02 E6 2A
				29 01 00 00 00 00 02 E7 0C
				29 01 00 00 00 00 02 E8 00
				29 01 00 00 00 00 02 E9 00
				29 01 00 00 00 00 02 EA 00
				29 01 00 00 00 00 02 EB 00
				29 01 00 00 00 00 02 EC 80
				29 01 00 00 00 00 02 ED 56
				29 01 00 00 00 00 02 EE 00
				29 01 00 00 00 00 02 EF 32
				29 01 00 00 00 00 02 F0 00
				29 01 00 00 00 00 02 F1 C0
				29 01 00 00 00 00 02 F2 FF
				29 01 00 00 00 00 02 F3 FF
				29 01 00 00 00 00 02 F4 54
				29 01 00 00 00 00 04 FF 78 07 02
				29 01 00 00 00 00 02 40 0A
				29 01 00 00 00 00 02 41 00
				29 01 00 00 00 00 02 42 07
				29 01 00 00 00 00 02 43 40
				29 01 00 00 00 00 02 53 07
				29 01 00 00 00 00 02 1B 02
				29 01 00 00 00 00 02 46 22
				29 01 00 00 00 00 02 47 03
				29 01 00 00 00 00 02 4F 01
				29 01 00 00 00 00 02 76 1F
				29 01 00 00 00 00 02 80 35
				29 01 00 00 00 00 02 06 84
				29 01 00 00 00 00 02 08 00
				29 01 00 00 00 00 02 0E 27
				29 01 00 00 00 00 02 0F 28
				29 01 00 00 00 00 04 FF 78 07 05
				29 01 00 00 00 00 02 1F 00
				29 01 00 00 00 00 02 72 56
				29 01 00 00 00 00 02 74 56
				29 01 00 00 00 00 02 76 51
				29 01 00 00 00 00 02 7A 51
				29 01 00 00 00 00 02 7B 7E
				29 01 00 00 00 00 02 7C 7E
				29 01 00 00 00 00 02 46 55
				29 01 00 00 00 00 02 47 75
				29 01 00 00 00 00 02 B5 55
				29 01 00 00 00 00 02 B7 75
				29 01 00 00 00 00 02 C6 1B
				29 01 00 00 00 00 02 56 FF
				29 01 00 00 00 00 04 FF 78 07 06
				29 01 00 00 00 00 02 C0 80
				29 01 00 00 00 00 02 C1 17
				29 01 00 00 00 00 02 C3 06
				29 01 00 00 00 00 02 13 13
				29 01 00 00 00 00 04 FF 78 07 08
				29 01 00 00 00 00 20 E0 00 00 27 5D 00 A3 D3 F7 15 2F 5A 97 29 C6 0D 41 2A 75 B0 D5 3F 06 2A 52 3F 6C 8E BD 0F D8 D9
				29 01 00 00 00 00 20 E1 00 00 27 5D 00 A3 D3 F7 15 2F 5A 97 29 C6 0D 41 2A 75 B0 D5 3F 06 2A 52 3F 6C 8E BD 0F D8 D9
				29 01 00 00 00 00 04 FF 78 07 0B
				29 01 00 00 00 00 02 94 88
				29 01 00 00 00 00 02 95 1F
				29 01 00 00 00 00 02 96 06
				29 01 00 00 00 00 02 97 06
				29 01 00 00 00 00 02 98 CB
				29 01 00 00 00 00 02 99 CB
				29 01 00 00 00 00 02 9A 08
				29 01 00 00 00 00 02 9B 52
				29 01 00 00 00 00 02 9C 06
				29 01 00 00 00 00 02 9D 06
				29 01 00 00 00 00 02 9E D0
				29 01 00 00 00 00 02 9F D0
				29 01 00 00 00 00 02 AA 02
				29 01 00 00 00 00 02 AB E0
				29 01 00 00 00 00 04 FF 78 07 0C
				29 01 00 00 00 00 02 80 24
				29 01 00 00 00 00 02 81 3B
				29 01 00 00 00 00 02 82 23
				29 01 00 00 00 00 02 83 2D
				29 01 00 00 00 00 02 84 23
				29 01 00 00 00 00 02 85 28
				29 01 00 00 00 00 02 86 23
				29 01 00 00 00 00 02 87 2F
				29 01 00 00 00 00 02 88 24
				29 01 00 00 00 00 02 89 39
				29 01 00 00 00 00 02 8A 23
				29 01 00 00 00 00 02 8B 31
				29 01 00 00 00 00 02 8C 23
				29 01 00 00 00 00 02 8D 29
				29 01 00 00 00 00 02 8E 23
				29 01 00 00 00 00 02 8F 32
				29 01 00 00 00 00 02 90 23
				29 01 00 00 00 00 02 91 2E
				29 01 00 00 00 00 02 92 24
				29 01 00 00 00 00 02 93 33
				29 01 00 00 00 00 02 94 24
				29 01 00 00 00 00 02 95 38
				29 01 00 00 00 00 02 96 24
				29 01 00 00 00 00 02 97 3D
				29 01 00 00 00 00 02 98 24
				29 01 00 00 00 00 02 99 36
				29 01 00 00 00 00 02 9A 24
				29 01 00 00 00 00 02 9B 34
				29 01 00 00 00 00 02 9C 24
				29 01 00 00 00 00 02 9D 3E
				29 01 00 00 00 00 02 9E 23
				29 01 00 00 00 00 02 9F 2C
				29 01 00 00 00 00 02 A0 23
				29 01 00 00 00 00 02 A1 2A
				29 01 00 00 00 00 02 A2 24
				29 01 00 00 00 00 02 A3 37
				29 01 00 00 00 00 02 A4 23
				29 01 00 00 00 00 02 A5 2B
				29 01 00 00 00 00 02 A6 24
				29 01 00 00 00 00 02 A7 35
				29 01 00 00 00 00 02 A8 24
				29 01 00 00 00 00 02 A9 40
				29 01 00 00 00 00 02 AA 24
				29 01 00 00 00 00 02 AB 3F
				29 01 00 00 00 00 02 AC 24
				29 01 00 00 00 00 02 AD 3A
				29 01 00 00 00 00 02 AE 24
				29 01 00 00 00 00 02 AF 3C
				29 01 00 00 00 00 02 B0 23
				29 01 00 00 00 00 02 B1 30
				29 01 00 00 00 00 04 FF 78 07 0E
				29 01 00 00 00 00 02 00 A3
				29 01 00 00 00 00 02 02 0F
				29 01 00 00 00 00 02 04 06
				29 01 00 00 00 00 02 13 04
				29 01 00 00 00 00 02 C0 12
				29 01 00 00 00 00 02 B0 21
				29 01 00 00 00 00 02 41 12
				29 01 00 00 00 00 02 43 12
				29 01 00 00 00 00 02 40 07
				29 01 00 00 00 00 02 45 0A
				29 01 00 00 00 00 02 46 F1
				29 01 00 00 00 00 02 47 00
				29 01 00 00 00 00 02 49 F0
				29 01 00 00 00 00 02 C8 78
				29 01 00 00 00 00 02 C9 78
				29 01 00 00 00 00 02 4D EF
				29 01 00 00 00 00 02 50 00
				29 01 00 00 00 00 02 4B 18
				29 01 00 00 00 00 02 05 20
				29 01 00 00 00 00 02 E0 0A
				29 01 00 00 00 00 02 E2 07
				29 01 00 00 00 00 02 E3 40
				29 01 00 00 00 00 02 E5 07
				29 01 00 00 00 00 04 FF 78 07 1E
				29 01 00 00 00 00 02 C9 02
				29 01 00 00 00 00 02 C0 1F
				29 01 00 00 00 00 02 C1 28
				29 01 00 00 00 00 02 C2 38
				29 01 00 00 00 00 02 C3 38
				29 01 00 00 00 00 02 C4 16
				29 01 00 00 00 00 02 C7 00
				29 01 00 00 00 00 04 FF 78 07 00
				29 01 00 00 00 00 02 35 00
				05 01 00 00 40 00 01 11
			];

			qcom,mdss-dsi-post-panel-on-command = [
			  05 01 00 00 3C 00 01 29
			];

		};
	};
};

&pm8150l_wled{
	qcom,string-cfg = <3>;
	qcom,fs-current-limit = <25000>;
};
