&mdss_mdp {
	dsi_s6e8aa5x01_amoled_video: qcom,mdss_dsi_s6e8aa5x01_amoled_hdp_video {
	qcom,mdss-dsi-panel-name =
		"s6e8aa5x01 amoled video mode dsi samsung panel with DSC";
	qcom,mdss-dsi-panel-type = "dsi_video_mode";
	qcom,mdss-dsi-panel-physical-type = "oled";
	qcom,dsi-ctrl-num = <0>;
	qcom,dsi-phy-num = <0>;

	qcom,mdss-dsi-virtual-channel-id = <0>;
	qcom,mdss-dsi-stream = <0>;
	qcom,mdss-dsi-bpp = <24>;
	qcom,mdss-dsi-border-color = <0>;
	qcom,mdss-dsi-traffic-mode = "non_burst_sync_event";
	qcom,mdss-dsi-bllp-eof-power-mode;
	qcom,mdss-dsi-bllp-power-mode;
	qcom,mdss-dsi-lane-0-state;
	qcom,mdss-dsi-lane-1-state;
	qcom,mdss-dsi-lane-2-state;
	qcom,mdss-dsi-lane-3-state;
	qcom,mdss-dsi-dma-trigger = "trigger_sw";
	qcom,mdss-dsi-mdp-trigger = "none";
	qcom,mdss-dsi-reset-sequence = <1 5>, <0 3>, <1 10>;
	qcom,adjust-timer-wakeup-ms = <1>;
//	qcom,mdss-dsi-panel-hdr-enabled;
//	qcom,mdss-dsi-panel-hdr-color-primaries = <14500 15500 32000
//		17000 15500 30000 8000 3000>;
	qcom,mdss-dsi-panel-peak-brightness = <4200000>;
	qcom,mdss-dsi-panel-blackness-level = <3230>;

	qcom,mdss-pan-physical-width-dimension = <62>;
	qcom,mdss-pan-physical-height-dimension = <128>;
	qcom,mdss-dsi-tx-eot-append;
	qcom,suspend-ulps-enabled;
	qcom,mdss-dsi-te-pin-select = <0>;
//	qcom,mdss-dsi-lp11-init;
	qcom,mdss-dsi-post-init-delay = <1>;

	qcom,mdss-dsi-min-refresh-rate = <55>;
	qcom,mdss-dsi-max-refresh-rate = <60>;

//	qcom,esd-check-enabled;
//	qcom,mdss-dsi-panel-status-check-mode = "reg_read";
//	qcom,mdss-dsi-panel-status-command = [06 01 00 01 00 00 01 0a];
//	qcom,mdss-dsi-panel-status-command-state = "dsi_lp_mode";
//	qcom,mdss-dsi-panel-status-value = <0x1C>;
//	qcom,mdss-dsi-panel-status-read-length = <1>;

	qcom,dsi-select-clocks = "mux_byte_clk0", "mux_pixel_clk0",
				"src_byte_clk0", "src_pixel_clk0",
				"shadow_byte_clk0", "shadow_pixel_clk0";

	qcom,panel-supply-entries = <&dsi_panel_pwr_supply>;
	qcom,mdss-dsi-bl-pmic-control-type = "bl_ctrl_wled";
	
	qcom,mdss-dsi-bl-min-level = <1>;
	qcom,mdss-dsi-bl-max-level = <3520>;
	qcom,mdss-brightness-max-level = <255>;

	qcom,platform-reset-gpio = <&pm8150l_gpios 3 0>;
	kc,vmipi-gpio = <&pm8150l_gpios 7 0>;
	kc,voled-gpio = <&tlmm 4 0>;
	kc,platform-lcd-det-gpio = <&tlmm 55 0>;

	qcom,mdss-dsi-force-clock-lane-hs;

	qcom,mdss-dsi-display-timings {
		timing@0 {
			qcom,mdss-dsi-panel-width = <720>;
			qcom,mdss-dsi-panel-height = <1480>;
			qcom,mdss-dsi-h-front-porch = <128>;
			qcom,mdss-dsi-h-back-porch = <16>;
			qcom,mdss-dsi-h-pulse-width = <12>;
			qcom,mdss-dsi-h-sync-skew = <0>;
			qcom,mdss-dsi-v-back-porch = <8>;
			qcom,mdss-dsi-v-front-porch = <12>;
			qcom,mdss-dsi-v-pulse-width = <4>;
			qcom,mdss-dsi-h-left-border = <0>;
			qcom,mdss-dsi-panel-framerate = <60>;

			qcom,mdss-dsi-on-command = [
			  05 01 00 00 14 00 02 11 00
			  15 01 00 00 00 00 02 51 FF
			  15 01 00 00 00 00 02 53 20
			  39 01 00 00 00 00 03 F0 5A 5A
			  39 01 00 00 00 00 04 C0 D8 D8 00
			  39 01 00 00 00 00 03 F0 A5 A5
			  39 01 00 00 00 00 03 F0 5A 5A
			  39 01 00 00 00 00 03 BD 11 44
			  39 01 00 00 00 00 03 F0 A5 A5
			  39 01 00 00 00 00 03 F0 5A 5A
			  39 01 00 00 00 00 05 F2 0C 0C B9 01
			  39 01 00 00 78 00 03 F0 A5 A5
			];

			qcom,mdss-dsi-post-panel-on-command = [
			  05 01 00 00 00 00 02 29 00
			];

			qcom,mdss-dsi-off-command = [
			  05 01 00 00 14 00 01 28
			  05 01 00 00 78 00 02 10 00
			];

			qcom,mdss-dsi-on-command-state = "dsi_lp_mode";
			qcom,mdss-dsi-post-on-command-state = "dsi_lp_mode";
			qcom,mdss-dsi-off-command-state = "dsi_lp_mode";

			qcom,mdss-dsi-panel-phy-timings = [00 12 04 04 12 1E 04 
				05 03 02 04 00 0F 09];

			qcom,display-topology = <1 0 1>;
			qcom,default-topology-index = <0>;

			};
		};
	};
};
