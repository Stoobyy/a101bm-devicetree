/*
 * This software is contributed or developed by KYOCERA Corporation.
 * (C) 2021 KYOCERA Corporation
 *
 */

/dts-v1/;
/plugin/;

#include "sm7250-MIZUKI-common.dtsi"
#include "sm7250-MIZUKI03.dtsi"


/ {
	model = " Qualcomm Technologies, Inc. SM7250 SoC MIZUKI03 rev10";
	compatible = "qcom,sm7250", "kc,mizuki03";
	qcom,board-id = <0x03100005 0>;
};

